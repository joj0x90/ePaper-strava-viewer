#include "EpaperDisplay.h"

#include <SPI.h>
#include <GxEPD2_BW.h>
#include <qrcode.h>  // ESP-IDF's QR code generator

#include "ActivityIcons.h"
#include "HeartRateChart.h"
#include "IconOverview.h"
#include "PolylineReader.h"
// ASCII + Latin-1 (ä, ö, ü, ß, é, ...), generated by tools/fonts/make_fonts.sh
#include "fonts/FreeSans12pt8b.h"
#include "fonts/FreeSans18pt8b.h"
#include "fonts/FreeSansBold24pt8b.h"

#ifndef FIRMWARE_VERSION
#define FIRMWARE_VERSION "dev"  // set by tools/version.py
#endif

#define HEADING_START_X 10
#define HEADING_START_Y 40

#define ICON_SIZE 40
#define HEADING_ICON_GAP 12

// Border around the kudos and comment count with its icon
#define BADGE_PADDING 8
#define BADGE_GAP 8
#define BADGE_BORDER 2
#define BADGE_RADIUS 8

// Icons centered on the cap height of the heading font (~25 px)
#define HEADING_ICON_Y (HEADING_START_Y - 12 - ICON_SIZE / 2)

#define BODY_START_X 20
#define BODY_START_Y 60
// Baseline of a first body line in the large font (FreeSans18pt8b): BODY_START_Y is the top of
// the body, and the capitals of that font are ~25 px tall
#define BODY_LARGE_BASELINE (BODY_START_Y + 25)

#define FOOTER_SIZE_Y 20

#define MAP_MARGIN 20
#define MAP_LINE_WIDTH 3

#define TEXTAREA_PADDING 8

// QR codes on the setup screens, with the text column next to or below them
#define QR_SIZE 220
#define QR_Y (BODY_START_Y + 10)
#define SETUP_TEXT_GAP 30

// Battery symbol in the footer's right corner, right of its charge in percent
#define BATTERY_W 28
#define BATTERY_H 14
#define BATTERY_NUB_W 3
#define BATTERY_NUB_H 6
#define BATTERY_GAP 6
// Bell in the footer's left corner while a firmware update is available
#define BELL_SIZE 18

// CS=15, DC=27, RST=26, BUSY=25
static GxEPD2_BW<GxEPD2_750_T7, GxEPD2_750_T7::HEIGHT> display(GxEPD2_750_T7(15, 27, 26, 25));

// Converts UTF-8 (as Strava sends it) to Latin-1, the encoding of the fonts above.
// Typographic quotes and dashes become ASCII; other characters (emoji, ...) are dropped.
static String utf8ToLatin1(const char *utf8) {
    String out;
    const uint8_t *s = (const uint8_t *)utf8;
    while (*s) {
        uint32_t cp;
        uint8_t extra;
        if (*s < 0x80) {
            cp = *s;
            extra = 0;
        } else if ((*s & 0xE0) == 0xC0) {
            cp = *s & 0x1F;
            extra = 1;
        } else if ((*s & 0xF0) == 0xE0) {
            cp = *s & 0x0F;
            extra = 2;
        } else if ((*s & 0xF8) == 0xF0) {
            cp = *s & 0x07;
            extra = 3;
        } else {  // invalid lead byte
            s++;
            continue;
        }
        s++;
        for (; extra > 0 && (*s & 0xC0) == 0x80; extra--, s++) cp = (cp << 6) | (*s & 0x3F);
        if (extra > 0) continue;  // truncated sequence

        if (cp < 0x80 || (cp >= 0xA0 && cp <= 0xFF)) {
            out += (char)cp;
        } else if (cp == 0x2018 || cp == 0x2019 || cp == 0x201A) {
            out += '\'';
        } else if (cp == 0x201C || cp == 0x201D || cp == 0x201E) {
            out += '"';
        } else if (cp == 0x2013 || cp == 0x2014) {
            out += '-';
        } else if (cp == 0x2026) {
            out += "...";
        }
    }
    return out;
}

static void printText(const char *utf8, uint16_t font_color = GxEPD_BLACK) {
    if (font_color != GxEPD_BLACK) {
        display.setTextColor(font_color);
    }
    display.print(utf8ToLatin1(utf8));
    if (font_color != GxEPD_BLACK) {
        display.setTextColor(GxEPD_BLACK);
    }
}

// Width from the cursor to the right end of the Latin-1 text, in the current font
static int16_t textWidth(const String &text) {
    int16_t x1, y1;
    uint16_t w, h;
    display.setTextWrap(false);  // otherwise long text is measured as wrapped at the screen edge
    display.getTextBounds(text, 0, 0, &x1, &y1, &w, &h);
    display.setTextWrap(true);  // Adafruit GFX default
    return x1 + w;
}

// Cuts the Latin-1 text so that it fits into maxWidth with "..." appended, if it's too wide.
// With force, "..." is appended even if the text fits, e.g. because more text follows.
static String ellipsize(String text, int16_t maxWidth, bool force = false) {
    if (!force && textWidth(text) <= maxWidth) return text;
    while (!text.isEmpty() && textWidth(text + "...") > maxWidth) {
        text.remove(text.length() - 1);
    }
    while (text.endsWith(" ")) text.remove(text.length() - 1);
    return text + "...";
}

// Converts the text to Latin-1 like printText() and, if it's wider than maxWidth in the
// current font, cuts it and appends "...".
static String fitText(const char *utf8, int16_t maxWidth) {
    return ellipsize(utf8ToLatin1(utf8), maxWidth);
}

// True if the text has anything but whitespace from index start on
static bool hasTextFrom(const String &text, size_t start) {
    for (size_t i = start; i < text.length(); i++) {
        if (!isspace((unsigned char)text[i])) return true;
    }
    return false;
}

// Length of the start of the paragraph that fits into maxWidth: as many whole words as fit,
// or as many characters as fit if even the first word is too long.
static size_t fittingLength(const String &paragraph, int16_t maxWidth) {
    if (textWidth(paragraph) <= maxWidth) return paragraph.length();

    size_t fit = 0;
    int space = paragraph.indexOf(' ');
    while (space >= 0 && textWidth(paragraph.substring(0, space)) <= maxWidth) {
        fit = space;
        space = paragraph.indexOf(' ', space + 1);
    }
    if (fit > 0) return fit;

    fit = 1;  // always at least one character, so the text gets shorter with every line
    while (fit < paragraph.length() && textWidth(paragraph.substring(0, fit + 1)) <= maxWidth) {
        fit++;
    }
    return fit;
}

// Box with the text inside, wrapped at spaces and newlines into at most maxLines lines; if
// the text needs more, the last line ends with "...". Like an HTML <textarea rows=maxLines>,
// the box always has the height of maxLines lines. Only draws into the buffer, like
// drawHeading(). Returns the y below the box.
static int16_t drawTextarea(const char *utf8, int16_t x, int16_t y, int16_t width, uint8_t maxLines,
                            const GFXfont *font) {
    display.setFont(font);
    int16_t x1, y1;
    uint16_t w, h;
    display.getTextBounds("\xC4g", 0, 0, &x1, &y1, &w, &h);  // tallest and lowest letters: Äg
    const int16_t ascent = -y1;
    const int16_t descent = h + y1;
    const int16_t lineHeight = font->yAdvance;
    const int16_t boxH = 2 * TEXTAREA_PADDING + (maxLines - 1) * lineHeight + ascent + descent;
    display.drawRoundRect(x, y, width, boxH, BADGE_RADIUS / 2, GxEPD_BLACK);

    String text = utf8ToLatin1(utf8);
    text.replace("\r", "");
    const int16_t textX = x + TEXTAREA_PADDING;
    const int16_t textW = width - 2 * TEXTAREA_PADDING;
    int16_t baseline = y + TEXTAREA_PADDING + ascent;
    size_t pos = 0;
    for (uint8_t line = 0; line < maxLines && hasTextFrom(text, pos); line++) {
        while (text[pos] == ' ') pos++;  // no spaces at the start of a line
        int newline = text.indexOf('\n', pos);
        const size_t paragraphEnd = newline >= 0 ? newline : text.length();
        const String paragraph = text.substring(pos, paragraphEnd);

        String lineText;
        if (line == maxLines - 1) {
            // last line: whatever doesn't fit (or follows in further paragraphs) becomes "..."
            lineText = ellipsize(paragraph, textW, hasTextFrom(text, paragraphEnd));
        } else {
            const size_t length = fittingLength(paragraph, textW);
            lineText = paragraph.substring(0, length);
            pos += length;
            if (pos == paragraphEnd && newline >= 0) pos++;  // the line ends with the paragraph
        }

        display.setCursor(textX, baseline);
        display.print(lineText);
        baseline += lineHeight;
    }
    return y + boxH;
}

// Achievement badge at the right end of the heading, with the count left of it.
// Only draws into the buffer, like drawHeading(). Returns the left end of what it drew,
// or the right end of the heading if there are no achievements.
static int16_t drawAchievements(uint8_t achievements) {
    const int16_t rightEnd = display.width() - HEADING_START_X;
    if (achievements == 0) return rightEnd;

    const int16_t iconX = rightEnd - ICON_SIZE;
    drawIcon(display, Icon::Achievement, iconX, HEADING_ICON_Y, ICON_SIZE, GxEPD_BLACK,
             GxEPD_WHITE);

    // you can probably only get max. 99 achievements
    char text[8];
    snprintf(text, sizeof(text), "%02ux", achievements < 99 ? achievements : 99);

    // right-align the text in front of the icon
    display.setFont(&FreeSans18pt8b);
    int16_t x1, y1;
    uint16_t w, h;
    display.getTextBounds(text, 0, HEADING_START_Y, &x1, &y1, &w, &h);
    const int16_t textX = iconX - HEADING_ICON_GAP - w;
    display.setCursor(textX - x1, HEADING_START_Y);
    display.print(text);
    return textX;
}

// Only draws into the buffer; call inside a firstPage()/nextPage() loop and never
// change the window here, that would clip everything drawn in the same loop.
static void drawHeading(const char *heading, uint8_t achievements, Icon icon = Icon::None) {
    drawIcon(display, icon, HEADING_START_X, HEADING_ICON_Y, ICON_SIZE, GxEPD_BLACK, GxEPD_WHITE);

    const int16_t headingEnd = drawAchievements(achievements) - HEADING_ICON_GAP;

    // the heading gets the space between the icon and the achievements, cut with "..."
    display.setFont(&FreeSans18pt8b);
    const int16_t heading_start = HEADING_START_X + ICON_SIZE + HEADING_ICON_GAP;
    display.setCursor(heading_start, HEADING_START_Y);
    display.print(fitText(heading, headingEnd - heading_start));

    const int16_t lineY = HEADING_START_Y + 5;
    display.drawLine(HEADING_START_X, lineY, display.width() - HEADING_START_X, lineY, GxEPD_BLACK);
}

// Draws icon, text and unit icon in one line, in the current font: the icons are centered
// vertically on the digits, with TEXTAREA_PADDING between the three. Icon::None as unit leaves
// it out. Only draws into the buffer, like drawHeading().
static void drawStatLine(Icon icon, const char *text, int16_t x, int16_t baseline) {
    int16_t x1, y1;
    uint16_t w, h;
    // center on the digit height, so every line is aligned the same, whatever its text
    display.getTextBounds("0", 0, 0, &x1, &y1, &w, &h);
    const int16_t iconY = baseline + y1 + h / 2 - ICON_SIZE / 2;  // y1 < 0: top of the digits

    drawIcon(display, icon, x, iconY, ICON_SIZE, GxEPD_BLACK, GxEPD_WHITE);

    const int16_t textX = x + ICON_SIZE + TEXTAREA_PADDING;
    display.setCursor(textX, baseline);
    printText(text);
}

// Converts a speed in m/s (as Strava sends it) to the pace in min/km, formatted as "=m:ss".
// A speed of 0, e.g. for activities without distance, gives "=-:--".
template <size_t N>
static void formatPace(char (&buf)[N], float speedMps) {
    if (speedMps <= 0) {
        snprintf(buf, N, "=-:--");
        return;
    }
    const uint32_t secondsPerKm = lroundf(1000 / speedMps);
    snprintf(buf, N, "=%lu:%02lu", (unsigned long)(secondsPerKm / 60),
             (unsigned long)(secondsPerKm % 60));
}

static void drawActivityStats(const StravaActivity &act) {
    char pace_max[12];
    char pace_avg[12];
    char kcal[6];
    char distance[11];
    formatPace(pace_max, act.max_speed);
    formatPace(pace_avg, act.average_speed);
    snprintf(kcal, sizeof(kcal), "=%4i", act.burned_calories);
    snprintf(distance, sizeof(distance), "%.2f km", act.distance_km);

    display.setFont(&FreeSans12pt8b);
    display.setCursor(BODY_START_X, BODY_START_Y + 20);
    printText(act.date.c_str());

    display.setCursor(BODY_START_X, BODY_START_Y + 45);
    printText(act.device_name.c_str());

    if (!act.description.isEmpty()) {
        const int16_t width = display.width() / 2 - MAP_MARGIN - BODY_START_X;
        drawTextarea(act.description.c_str(), BODY_START_X, BODY_START_Y + 55, width, 3,
                     &FreeSans12pt8b);
    }

    display.setFont(&FreeSans18pt8b);

    // print pace_max
    int16_t y = 300;
    drawStatLine(Icon::MaxSpeed, pace_max, BODY_START_X, y);

    // print pace_avg
    drawStatLine(Icon::AvgSpeed, pace_avg, BODY_START_X + display.width() / 4, y);

    y = 350;
    // print distance with the ruler in front, both centered in the left half
    drawStatLine(Icon::Distance, distance, BODY_START_X, y);

    // print burned kcal
    drawStatLine(Icon::Calories, kcal, BODY_START_X + display.width() / 4, y);
}

// Area of the map or heart rate chart: the right half of the screen below the heading
struct Box {
    int16_t x, y, w, h;
};

static Box rightHalfBox() {
    Box box;
    box.x = display.width() / 2 + MAP_MARGIN;
    box.y = HEADING_START_Y + 20 + MAP_MARGIN;  // below the heading line
    box.w = display.width() - box.x - MAP_MARGIN;
    box.h = display.height() - FOOTER_SIZE_Y - MAP_MARGIN - box.y;
    return box;
}

// Draws the route, fitted into rightHalfBox(). Only draws into the buffer, like drawHeading().
static void drawActivityMap(const String &polyline) {
    // Bounding box of the route, in 1e-5 degrees
    int32_t lat, lng;
    int32_t minLat = INT32_MAX, maxLat = INT32_MIN, minLng = INT32_MAX, maxLng = INT32_MIN;
    PolylineReader bounds(polyline.c_str());
    while (bounds.next(lat, lng)) {
        minLat = min(minLat, lat);
        maxLat = max(maxLat, lat);
        minLng = min(minLng, lng);
        maxLng = max(maxLng, lng);
    }
    if (minLat > maxLat) return;  // no points

    // A degree of longitude gets shorter towards the poles
    const float midLatRad = (minLat + maxLat) / 2 * 1e-5f * DEG_TO_RAD;
    const float lngFactor = cosf(midLatRad);
    const float routeW = (maxLng - minLng) * lngFactor;
    const float routeH = maxLat - minLat;

    const Box box = rightHalfBox();

    // Same scale on both axes, so the route isn't distorted; centered in the box
    const float scale =
        min(routeW > 0 ? box.w / routeW : INFINITY, routeH > 0 ? box.h / routeH : INFINITY);
    const float s = isinf(scale) ? 0 : scale;  // a single point: draw it in the center
    const float offsetX = box.x + (box.w - routeW * s) / 2;
    const float offsetY = box.y + (box.h - routeH * s) / 2;

    PolylineReader route(polyline.c_str());
    int16_t prevX = 0, prevY = 0;
    bool first = true;
    while (route.next(lat, lng)) {
        const int16_t x = offsetX + (lng - minLng) * lngFactor * s;
        const int16_t y = offsetY + (maxLat - lat) * s;  // north is up
        if (first) {
            display.fillCircle(x, y, MAP_LINE_WIDTH, GxEPD_BLACK);  // start point
            first = false;
        } else {
            // Thick line: the same line shifted by up to ±1 px in both directions
            for (int8_t d = -(MAP_LINE_WIDTH / 2); d <= MAP_LINE_WIDTH / 2; d++) {
                display.drawLine(prevX + d, prevY, x + d, y, GxEPD_BLACK);
                display.drawLine(prevX, prevY + d, x, y + d, GxEPD_BLACK);
            }
        }
        prevX = x;
        prevY = y;
    }
}

// Draws "85%" and a battery symbol filled to match, ending at rightX and vertically centered
// on the digits resting on baseline. Returns the width drawn.
static int16_t drawBattery(int8_t percent, int16_t rightX, int16_t baseline) {
    char text[5];
    snprintf(text, sizeof(text), "%d%%", percent);
    int16_t x1, y1;
    uint16_t w, h;
    display.getTextBounds(text, 0, baseline, &x1, &y1, &w, &h);

    const int16_t bodyX = rightX - BATTERY_NUB_W - BATTERY_W;
    const int16_t bodyY = y1 + (int16_t)h / 2 - BATTERY_H / 2;
    display.drawRect(bodyX, bodyY, BATTERY_W, BATTERY_H, GxEPD_BLACK);
    display.fillRect(bodyX + BATTERY_W, bodyY + (BATTERY_H - BATTERY_NUB_H) / 2, BATTERY_NUB_W,
                     BATTERY_NUB_H, GxEPD_BLACK);
    // filled level inside a 1 px white gap to the border
    const int16_t levelW = (BATTERY_W - 4) * percent / 100;
    display.fillRect(bodyX + 2, bodyY + 2, levelW, BATTERY_H - 4, GxEPD_BLACK);

    const int16_t textX = bodyX - BATTERY_GAP - w;
    display.setCursor(textX - x1, baseline);
    display.print(text);
    return rightX - textX;
}

// Bell at leftX, vertically centered on digits resting on baseline (like the battery).
// Returns the width drawn.
static int16_t drawUpdateBell(int16_t leftX, int16_t baseline) {
    int16_t x1, y1;
    uint16_t w, h;
    display.getTextBounds("0", 0, baseline, &x1, &y1, &w, &h);
    drawIcon(display, Icon::Bell, leftX, y1 + (int16_t)h / 2 - BELL_SIZE / 2, BELL_SIZE,
             GxEPD_BLACK, GxEPD_WHITE);
    return BELL_SIZE;
}

// Firmware version, followed by the notice if there is one, e.g. a failed update, the battery
// charge in the right corner unless batteryPercent is negative (no battery), and a bell in the
// left corner if a firmware update is available.
static void drawFooter(const char *notice = "", int8_t batteryPercent = -1,
                       bool updateAvailable = false) {
    display.setFont(&FreeSans12pt8b);
    const int16_t y = display.height() - (FOOTER_SIZE_Y / 2);

    int16_t batteryW = 0;
    if (batteryPercent >= 0) {
        batteryW = drawBattery(batteryPercent, display.width() - HEADING_START_X, y);
    }
    const int16_t bellW = updateAvailable ? drawUpdateBell(HEADING_START_X, y) : 0;

    String text = FIRMWARE_VERSION;
    if (notice[0] != '\0') {
        text += " | ";
        text += notice;
    }
    // keep the same distance to both edges, so the centered text never reaches the battery or
    // the bell
    const int16_t cornerW = max(batteryW, bellW);
    const int16_t sideW = HEADING_START_X + (cornerW > 0 ? cornerW + BATTERY_GAP : 0);
    const String fitted = fitText(text.c_str(), display.width() - 2 * sideW);

    // center the text horizontally, whatever its length
    int16_t x1, y1;
    uint16_t w, h;
    display.getTextBounds(fitted, 0, y, &x1, &y1, &w, &h);
    display.setCursor((display.width() - w) / 2 - x1, y);
    display.print(fitted);
}

static void formatCount(char (&buf)[4], uint16_t count) {
    if (count > 99) {
        strcpy(buf, "99+");
    } else {
        snprintf(buf, sizeof(buf), "%u", count);
    }
}

// Draws the count in black left of the icon, with a rounded border around both,
// centered horizontally on centerX and resting on the footer.
static void drawCountBadge(Icon icon, const char *count, int16_t centerX) {
    display.setFont(&FreeSans12pt8b);
    int16_t x1, y1;
    uint16_t w, h;
    display.getTextBounds(count, 0, 0, &x1, &y1, &w, &h);

    const int16_t boxW = BADGE_PADDING + w + BADGE_GAP + ICON_SIZE + BADGE_PADDING;
    const int16_t boxH = BADGE_PADDING + ICON_SIZE + BADGE_PADDING;
    const int16_t boxX = centerX - boxW / 2;
    const int16_t boxY = display.height() - FOOTER_SIZE_Y * 2 - boxH;
    for (int16_t i = 0; i < BADGE_BORDER; i++) {
        display.drawRoundRect(boxX + i, boxY + i, boxW - 2 * i, boxH - 2 * i, BADGE_RADIUS - i,
                              GxEPD_BLACK);
    }

    // x1/y1 are the offsets from the cursor to the text's top left corner (y1 < 0)
    const int16_t iconY = boxY + BADGE_PADDING;
    display.setCursor(boxX + BADGE_PADDING - x1, iconY + ICON_SIZE / 2 - h / 2 - y1);
    printText(count);

    const int16_t iconX = boxX + BADGE_PADDING + w + BADGE_GAP;
    drawIcon(display, icon, iconX, iconY, ICON_SIZE, GxEPD_BLACK, GxEPD_WHITE);
}

static void drawKudosComments(uint8_t kudos, uint8_t comments) {
    // we will display at most 99+
    char count[4];

    // kudos at 1/3 of the left half
    formatCount(count, kudos);
    drawCountBadge(Icon::Kudos, count, display.width() / 2 / 3);

    // comments at 2/3 of the left half
    formatCount(count, comments);
    drawCountBadge(Icon::Comment, count, display.width() / 2 * 2 / 3);
}

// The whole activity screen. Only draws into the buffer, like drawHeading().
static void drawActivityScreen(const StravaActivity &act, const char *footerNotice,
                               int8_t batteryPercent, bool updateAvailable) {
    display.fillScreen(GxEPD_WHITE);
    display.setTextColor(GxEPD_BLACK);

    drawHeading(act.name.c_str(), act.achievement_count, iconForSportType(act.type.c_str()));

    drawActivityStats(act);

    // the right half shows the map, or the heart rate for activities without one (swims)
    const bool heartRateChart = !act.showMap && act.heart_rate.count > 0;
    if (act.showMap || heartRateChart) {
        display.drawLine(display.width() / 2, BODY_START_Y, display.width() / 2,
                         display.height() - (FOOTER_SIZE_Y * 2), GxEPD_BLACK);
    }
    if (act.showMap) {
        drawActivityMap(act.map);
    } else if (heartRateChart) {
        const Box box = rightHalfBox();
        drawHeartRateChart(display, act.heart_rate.bpm, act.heart_rate.count,
                           lroundf(act.average_heartrate), lroundf(act.max_heartrate),
                           &FreeSans12pt8b, box.x, box.y, box.w, box.h, GxEPD_BLACK, GxEPD_WHITE);
        display.setTextWrap(true);  // Adafruit GFX default, which the chart turned off
    }

    drawKudosComments(act.kudos_count, act.comment_count);

    drawFooter(footerNotice, batteryPercent, updateAvailable);
}

void drawActivity(const StravaActivity &act, const char *footerNotice, int8_t batteryPercent,
                  bool updateAvailable) {
    display.setFullWindow();
    display.firstPage();
    do {
        drawActivityScreen(act, footerNotice, batteryPercent, updateAvailable);
    } while (display.nextPage());
}

void drawActivityChanges(const StravaActivity &shown, const char *shownNotice,
                         int8_t shownBatteryPercent, bool shownUpdateAvailable,
                         const StravaActivity &act, const char *footerNotice, int8_t batteryPercent,
                         bool updateAvailable) {
    // the partial refresh only changes the pixels that differ from the previous image, which
    // the controller lost in hibernate(): give it back what the screen shows
    display.setFullWindow();
    display.firstPage();
    do {
        drawActivityScreen(shown, shownNotice, shownBatteryPercent, shownUpdateAvailable);
    } while (display.nextPageToPrevious());

    display.setPartialWindow(0, 0, display.width(), display.height());
    display.firstPage();
    do {
        drawActivityScreen(act, footerNotice, batteryPercent, updateAvailable);
    } while (display.nextPage());
}

void drawError(const char *message) {
    display.setFullWindow();
    display.firstPage();
    do {
        display.fillScreen(GxEPD_WHITE);
        display.setTextColor(GxEPD_BLACK);
        drawHeading("Error:", 0, Icon::Error);
        display.setFont(&FreeSans18pt8b);
        display.setCursor(BODY_START_X, BODY_LARGE_BASELINE);
        printText(message);
    } while (display.nextPage());
}

void drawUpdate(const char *fromVersion, const char *toVersion) {
    display.setFullWindow();
    display.firstPage();
    do {
        display.fillScreen(GxEPD_WHITE);
        display.setTextColor(GxEPD_BLACK);
        drawHeading("Updating firmware", 0, Icon::None);
        display.setFont(&FreeSans18pt8b);
        display.setCursor(BODY_START_X, BODY_LARGE_BASELINE);
        printText((String(fromVersion) + " -> " + toVersion).c_str());
        display.setFont(&FreeSans12pt8b);
        display.setCursor(BODY_START_X, BODY_LARGE_BASELINE + 50);
        printText("Downloading the new firmware, this can take a minute.");
        display.setCursor(BODY_START_X, BODY_LARGE_BASELINE + 80);
        printText("The latest activity will be shown afterwards.");
        drawFooter();
    } while (display.nextPage());
}

// esp_qrcode_generate() hands the code to a callback without a context pointer, so drawQrCode()
// leaves the target square here.
static struct {
    int16_t x, y, size;
} qrTarget;

static void drawQrModules(esp_qrcode_handle_t qrcode) {
    const int modules = esp_qrcode_get_size(qrcode);
    const int16_t scale = qrTarget.size / modules;  // whole pixels per module keep it sharp
    const int16_t offset = (qrTarget.size - scale * modules) / 2;
    for (int y = 0; y < modules; y++) {
        for (int x = 0; x < modules; x++) {
            if (esp_qrcode_get_module(qrcode, x, y)) {
                display.fillRect(qrTarget.x + offset + x * scale, qrTarget.y + offset + y * scale,
                                 scale, scale, GxEPD_BLACK);
            }
        }
    }
}

// QR code as large as fits into the square (x, y, size, size), centered in it. The screen's
// white background around it serves as the quiet zone. Only draws into the buffer.
static void drawQrCode(const char *text, int16_t x, int16_t y, int16_t size) {
    qrTarget = {x, y, size};
    esp_qrcode_config_t config = ESP_QRCODE_CONFIG_DEFAULT();
    config.display_func = drawQrModules;
    config.qrcode_ecc_level = ESP_QRCODE_ECC_MED;
    esp_qrcode_generate(&config, text);
}

// Content of a QR code that connects a phone to the WiFi when scanned with its camera.
static String wifiQrText(const char *ssid, const char *password) {
    auto escape = [](const char *text) {
        String out;
        for (; *text; text++) {
            if (strchr("\\;,:\"", *text)) out += '\\';
            out += *text;
        }
        return out;
    };
    return "WIFI:T:WPA;S:" + escape(ssid) + ";P:" + escape(password) + ";;";
}

// Prints the text centered on centerX in the current font, cut with "..." if wider than maxWidth.
static void printCentered(const char *utf8, int16_t centerX, int16_t baseline, int16_t maxWidth) {
    const String fitted = fitText(utf8, maxWidth);
    int16_t x1, y1;
    uint16_t w, h;
    display.getTextBounds(fitted, 0, baseline, &x1, &y1, &w, &h);
    display.setCursor(centerX - w / 2 - x1, baseline);
    display.print(fitted);
}

// Prints the text in the font, wrapped at spaces into lines of at most maxWidth. Returns the
// baseline of the line below.
static int16_t printWrapped(const char *utf8, const GFXfont *font, int16_t x, int16_t baseline,
                            int16_t maxWidth) {
    display.setFont(font);
    const String text = utf8ToLatin1(utf8);
    size_t pos = 0;
    while (hasTextFrom(text, pos)) {
        while (text[pos] == ' ') pos++;  // no spaces at the start of a line
        const size_t length = fittingLength(text.substring(pos), maxWidth);
        display.setCursor(x, baseline);
        display.print(text.substring(pos, pos + length));
        pos += length;
        baseline += font->yAdvance;
    }
    return baseline;
}

void drawSetupAccessPoint(const char *apSsid, const char *apPassword, const char *url,
                          uint8_t minutes) {
    const int16_t columnW = display.width() / 2;
    const int16_t textW = columnW - 2 * BODY_START_X;
    const String joinWifi = wifiQrText(apSsid, apPassword);
    char ends[48];
    snprintf(ends, sizeof(ends), "The setup mode ends after %u minutes.", minutes);

    display.setFullWindow();
    display.firstPage();
    do {
        display.fillScreen(GxEPD_WHITE);
        display.setTextColor(GxEPD_BLACK);
        drawHeading("Setup", 0);

        drawQrCode(joinWifi.c_str(), columnW / 2 - QR_SIZE / 2, QR_Y, QR_SIZE);
        drawQrCode(url, columnW + columnW / 2 - QR_SIZE / 2, QR_Y, QR_SIZE);
        display.drawLine(columnW, QR_Y, columnW, QR_Y + QR_SIZE + 100, GxEPD_BLACK);

        display.setFont(&FreeSans12pt8b);
        const int16_t lineH = FreeSans12pt8b.yAdvance;
        int16_t y = QR_Y + QR_SIZE + SETUP_TEXT_GAP;
        printCentered("1. Connect to the WiFi", columnW / 2, y, textW);
        printCentered((String("Name: ") + apSsid).c_str(), columnW / 2, y + lineH, textW);
        printCentered((String("Password: ") + apPassword).c_str(), columnW / 2, y + 2 * lineH,
                      textW);
        printCentered("2. Open the setup page", columnW * 3 / 2, y, textW);
        printCentered(url, columnW * 3 / 2, y + lineH, textW);
        printCentered("(opens by itself on most phones)", columnW * 3 / 2, y + 2 * lineH, textW);

        printCentered(ends, display.width() / 2, y + 2 * lineH + 45, display.width());
        drawFooter();
    } while (display.nextPage());
}

void drawSetupInWifi(const char *url, const char *mdnsUrl, const char *wifiSsid,
                     const char *message, uint8_t minutes) {
    const int16_t qrSize = QR_SIZE + 60;
    const int16_t textX = BODY_START_X + qrSize + SETUP_TEXT_GAP;
    const int16_t textW = display.width() - textX - BODY_START_X;
    const String scan = String(
                            "Scan the QR code, or open this address in a browser connected to "
                            "the WiFi \"") +
                        wifiSsid + "\":";
    char ends[80];
    snprintf(ends, sizeof(ends),
             "The setup mode ends after %u minutes, or when you save the settings.", minutes);

    display.setFullWindow();
    display.firstPage();
    do {
        display.fillScreen(GxEPD_WHITE);
        display.setTextColor(GxEPD_BLACK);
        if (message[0] != '\0') {
            drawHeading(message, 0, Icon::Error);
        } else {
            drawHeading("Setup", 0);
        }
        drawQrCode(url, BODY_START_X, QR_Y, qrSize);

        int16_t y = QR_Y + SETUP_TEXT_GAP;
        y = printWrapped(scan.c_str(), &FreeSans12pt8b, textX, y, textW) + 15;
        y = printWrapped(url, &FreeSans18pt8b, textX, y, textW);
        y = printWrapped((String("or ") + mdnsUrl).c_str(), &FreeSans12pt8b, textX, y, textW);
        printWrapped(ends, &FreeSans12pt8b, textX, y + 30, textW);
        drawFooter();
    } while (display.nextPage());
}

void drawSetupHint(const char *heading, const char *message, SetupHint hint, const char *apSsid,
                   const char *apPassword, const char *apUrl, uint8_t minutes) {
    const int16_t qrY = BODY_START_Y + 60;
    const int16_t textX = BODY_START_X + QR_SIZE + SETUP_TEXT_GAP;
    const int16_t textW = display.width() - textX - BODY_START_X;
    const String joinWifi = wifiQrText(apSsid, apPassword);
    const char *press = hint == SetupHint::NotSetUp
                            ? "To set up the device, press the button on it."
                            : "To change the settings, press the button on the device.";
    char ownWifi[160];
    snprintf(ownWifi, sizeof(ownWifi),
             "%s its own WiFi for %u minutes. Scan the QR code to connect to it, or use:",
             hint == SetupHint::NotSetUp ? "It then opens"
                                         : "If it can't connect to your WiFi, it opens",
             minutes);
    const String then = String("Then open ") + apUrl + " (opens by itself on most phones).";
    char inWifi[200];
    snprintf(inWifi, sizeof(inWifi),
             "It then shows a QR code for the setup page in your WiFi, for %u minutes. Enter the "
             "Strava Client ID, Client secret and Refresh token there (see the README).",
             minutes);

    display.setFullWindow();
    display.firstPage();
    do {
        display.fillScreen(GxEPD_WHITE);
        display.setTextColor(GxEPD_BLACK);
        drawHeading(heading, 0, Icon::Error);
        display.setFont(&FreeSans18pt8b);
        display.setCursor(BODY_START_X, BODY_LARGE_BASELINE);
        display.print(fitText(message, display.width() - 2 * BODY_START_X));

        if (hint == SetupHint::StravaFailed) {  // the WiFi works, its own isn't needed
            int16_t y = qrY + 20;
            const int16_t fullW = display.width() - 2 * BODY_START_X;
            y = printWrapped("To log in to Strava, press the button on the device.",
                             &FreeSans12pt8b, BODY_START_X, y, fullW) +
                10;
            printWrapped(inWifi, &FreeSans12pt8b, BODY_START_X, y, fullW);
        } else {
            drawQrCode(joinWifi.c_str(), BODY_START_X, qrY, QR_SIZE);

            int16_t y = qrY + 20;
            y = printWrapped(press, &FreeSans12pt8b, textX, y, textW) + 10;
            y = printWrapped(ownWifi, &FreeSans12pt8b, textX, y, textW);
            y = printWrapped((String("Name: ") + apSsid).c_str(), &FreeSans12pt8b, textX, y, textW);
            y = printWrapped((String("Password: ") + apPassword).c_str(), &FreeSans12pt8b, textX, y,
                             textW) +
                10;
            printWrapped(then.c_str(), &FreeSans12pt8b, textX, y, textW);
        }
        drawFooter();
    } while (display.nextPage());
}

void drawIconOverviewScreen() {
    display.setFullWindow();
    display.firstPage();
    do {
        drawIconOverview(display, GxEPD_BLACK, GxEPD_WHITE);
    } while (display.nextPage());
}

void hibernateDisplay() {
    display.hibernate();
}

void initDisplay(bool keepScreen) {
    SPI.end();
    SPI.begin(13, 12, 14, 15);  // SCK=13, MISO=12 (unused), MOSI=14, SS=15
    // initial makes the first refresh a full one, which a partial refresh mustn't be
    display.init(115200, !keepScreen, 2, false);
    display.setRotation(0);
}
