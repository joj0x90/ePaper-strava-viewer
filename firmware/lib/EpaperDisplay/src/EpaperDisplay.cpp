#include "EpaperDisplay.h"

#include <SPI.h>
#include <GxEPD2_BW.h>

#include "ActivityIcons.h"
#include "IconOverview.h"
#include "PolylineReader.h"
// ASCII + Latin-1 (ä, ö, ü, ß, é, ...), generated by tools/fonts/make_fonts.sh
#include "fonts/FreeSans12pt8b.h"
#include "fonts/FreeSans18pt8b.h"
#include "fonts/FreeSansBold24pt8b.h"

#define VERSION "v0.0.3"

#define HEADING_START_X 10
#define HEADING_START_Y 40

#define HEADING_ICON_SIZE 40
#define HEADING_ICON_GAP 12

// Icons centered on the cap height of the heading font (~25 px)
#define HEADING_ICON_Y (HEADING_START_Y - 12 - HEADING_ICON_SIZE / 2)

#define BODY_START_X 20
#define BODY_START_Y 100

#define FOOTER_SIZE_Y 20

#define MAP_MARGIN 20
#define MAP_LINE_WIDTH 3

#define TEXTAREA_PADDING 8

// CS=15, DC=27, RST=26, BUSY=25
static GxEPD2_BW<GxEPD2_750_T7, GxEPD2_750_T7::HEIGHT> display(GxEPD2_750_T7(15, 27, 26, 25));

// Converts UTF-8 (as Strava sends it) to Latin-1, the encoding of the fonts above.
// Typographic quotes and dashes become ASCII; other characters (emoji, ...) are dropped.
static String utf8ToLatin1(const char *utf8) {
    String out;
    const uint8_t *s = (const uint8_t *)utf8;
    while (*s) {
        uint32_t cp;
        uint8_t extra;
        if (*s < 0x80) {
            cp = *s;
            extra = 0;
        } else if ((*s & 0xE0) == 0xC0) {
            cp = *s & 0x1F;
            extra = 1;
        } else if ((*s & 0xF0) == 0xE0) {
            cp = *s & 0x0F;
            extra = 2;
        } else if ((*s & 0xF8) == 0xF0) {
            cp = *s & 0x07;
            extra = 3;
        } else {  // invalid lead byte
            s++;
            continue;
        }
        s++;
        for (; extra > 0 && (*s & 0xC0) == 0x80; extra--, s++) cp = (cp << 6) | (*s & 0x3F);
        if (extra > 0) continue;  // truncated sequence

        if (cp < 0x80 || (cp >= 0xA0 && cp <= 0xFF)) {
            out += (char)cp;
        } else if (cp == 0x2018 || cp == 0x2019 || cp == 0x201A) {
            out += '\'';
        } else if (cp == 0x201C || cp == 0x201D || cp == 0x201E) {
            out += '"';
        } else if (cp == 0x2013 || cp == 0x2014) {
            out += '-';
        } else if (cp == 0x2026) {
            out += "...";
        }
    }
    return out;
}

static void printText(const char *utf8) {
    display.print(utf8ToLatin1(utf8));
}

// Width from the cursor to the right end of the Latin-1 text, in the current font
static int16_t textWidth(const String &text) {
    int16_t x1, y1;
    uint16_t w, h;
    display.setTextWrap(false);  // otherwise long text is measured as wrapped at the screen edge
    display.getTextBounds(text, 0, 0, &x1, &y1, &w, &h);
    display.setTextWrap(true);  // Adafruit GFX default
    return x1 + w;
}

// Cuts the Latin-1 text so that it fits into maxWidth with "..." appended, if it's too wide.
// With force, "..." is appended even if the text fits, e.g. because more text follows.
static String ellipsize(String text, int16_t maxWidth, bool force = false) {
    if (!force && textWidth(text) <= maxWidth) return text;
    while (!text.isEmpty() && textWidth(text + "...") > maxWidth) {
        text.remove(text.length() - 1);
    }
    while (text.endsWith(" ")) text.remove(text.length() - 1);
    return text + "...";
}

// Converts the text to Latin-1 like printText() and, if it's wider than maxWidth in the
// current font, cuts it and appends "...".
static String fitText(const char *utf8, int16_t maxWidth) {
    return ellipsize(utf8ToLatin1(utf8), maxWidth);
}

// True if the text has anything but whitespace from index start on
static bool hasTextFrom(const String &text, size_t start) {
    for (size_t i = start; i < text.length(); i++) {
        if (!isspace((unsigned char)text[i])) return true;
    }
    return false;
}

// Length of the start of the paragraph that fits into maxWidth: as many whole words as fit,
// or as many characters as fit if even the first word is too long.
static size_t fittingLength(const String &paragraph, int16_t maxWidth) {
    if (textWidth(paragraph) <= maxWidth) return paragraph.length();

    size_t fit = 0;
    int space = paragraph.indexOf(' ');
    while (space >= 0 && textWidth(paragraph.substring(0, space)) <= maxWidth) {
        fit = space;
        space = paragraph.indexOf(' ', space + 1);
    }
    if (fit > 0) return fit;

    fit = 1;  // always at least one character, so the text gets shorter with every line
    while (fit < paragraph.length() && textWidth(paragraph.substring(0, fit + 1)) <= maxWidth) {
        fit++;
    }
    return fit;
}

// Box with the text inside, wrapped at spaces and newlines into at most maxLines lines; if
// the text needs more, the last line ends with "...". Like an HTML <textarea rows=maxLines>,
// the box always has the height of maxLines lines. Only draws into the buffer, like
// drawHeading(). Returns the y below the box.
static int16_t drawTextarea(const char *utf8, int16_t x, int16_t y, int16_t width, uint8_t maxLines,
                            const GFXfont *font) {
    display.setFont(font);
    int16_t x1, y1;
    uint16_t w, h;
    display.getTextBounds("\xC4g", 0, 0, &x1, &y1, &w, &h);  // tallest and lowest letters: Äg
    const int16_t ascent = -y1;
    const int16_t descent = h + y1;
    const int16_t lineHeight = font->yAdvance;
    const int16_t boxH = 2 * TEXTAREA_PADDING + (maxLines - 1) * lineHeight + ascent + descent;
    display.drawRect(x, y, width, boxH, GxEPD_BLACK);

    String text = utf8ToLatin1(utf8);
    text.replace("\r", "");
    const int16_t textX = x + TEXTAREA_PADDING;
    const int16_t textW = width - 2 * TEXTAREA_PADDING;
    int16_t baseline = y + TEXTAREA_PADDING + ascent;
    size_t pos = 0;
    for (uint8_t line = 0; line < maxLines && hasTextFrom(text, pos); line++) {
        while (text[pos] == ' ') pos++;  // no spaces at the start of a line
        int newline = text.indexOf('\n', pos);
        const size_t paragraphEnd = newline >= 0 ? newline : text.length();
        const String paragraph = text.substring(pos, paragraphEnd);

        String lineText;
        if (line == maxLines - 1) {
            // last line: whatever doesn't fit (or follows in further paragraphs) becomes "..."
            lineText = ellipsize(paragraph, textW, hasTextFrom(text, paragraphEnd));
        } else {
            const size_t length = fittingLength(paragraph, textW);
            lineText = paragraph.substring(0, length);
            pos += length;
            if (pos == paragraphEnd && newline >= 0) pos++;  // the line ends with the paragraph
        }

        display.setCursor(textX, baseline);
        display.print(lineText);
        baseline += lineHeight;
    }
    return y + boxH;
}

// Achievement badge at the right end of the heading, with the count left of it.
// Only draws into the buffer, like drawHeading(). Returns the left end of what it drew,
// or the right end of the heading if there are no achievements.
static int16_t drawAchievements(uint8_t achievements) {
    const int16_t rightEnd = display.width() - HEADING_START_X;
    if (achievements == 0) return rightEnd;

    const int16_t iconX = rightEnd - HEADING_ICON_SIZE;
    drawIcon(display, Icon::Achievement, iconX, HEADING_ICON_Y, HEADING_ICON_SIZE, GxEPD_BLACK,
             GxEPD_WHITE);

    // you can probably only get max. 99 achievements
    char text[8];
    snprintf(text, sizeof(text), "%02ux", achievements < 99 ? achievements : 99);

    // right-align the text in front of the icon
    display.setFont(&FreeSans18pt8b);
    int16_t x1, y1;
    uint16_t w, h;
    display.getTextBounds(text, 0, HEADING_START_Y, &x1, &y1, &w, &h);
    const int16_t textX = iconX - HEADING_ICON_GAP - w;
    display.setCursor(textX - x1, HEADING_START_Y);
    display.print(text);
    return textX;
}

// Only draws into the buffer; call inside a firstPage()/nextPage() loop and never
// change the window here, that would clip everything drawn in the same loop.
static void drawHeading(const char *heading, uint8_t achievements, Icon icon = Icon::None) {
    drawIcon(display, icon, HEADING_START_X, HEADING_ICON_Y, HEADING_ICON_SIZE, GxEPD_BLACK,
             GxEPD_WHITE);

    const int16_t headingEnd = drawAchievements(achievements) - HEADING_ICON_GAP;

    // the heading gets the space between the icon and the achievements, cut with "..."
    display.setFont(&FreeSans18pt8b);
    const int16_t heading_start = HEADING_START_X + HEADING_ICON_SIZE + HEADING_ICON_GAP;
    display.setCursor(heading_start, HEADING_START_Y);
    display.print(fitText(heading, headingEnd - heading_start));

    const int16_t lineY = HEADING_START_Y + 20;
    display.drawLine(HEADING_START_X, lineY, display.width() - HEADING_START_X, lineY, GxEPD_BLACK);
}

static void drawActivityStats(StravaActivity act) {
    char distance[16];
    snprintf(distance, sizeof(distance), "%.2f km", act.distance_km);

    display.setFont(&FreeSans12pt8b);
    display.setCursor(BODY_START_X, BODY_START_Y);
    printText(act.date.c_str());

    if (!act.description.isEmpty()) {
        const int16_t width = display.width() / 2 - MAP_MARGIN - BODY_START_X;
        drawTextarea(act.description.c_str(), BODY_START_X, BODY_START_Y + 15, width, 3,
                     &FreeSans12pt8b);
    }

    display.setFont(&FreeSans18pt8b);
    display.setCursor(BODY_START_X, 380);
    display.print(distance);
}

// Draws the route, fitted into the right half of the screen below the heading.
// Only draws into the buffer, like drawHeading().
static void drawActivityMap(const String &polyline) {
    // Bounding box of the route, in 1e-5 degrees
    int32_t lat, lng;
    int32_t minLat = INT32_MAX, maxLat = INT32_MIN, minLng = INT32_MAX, maxLng = INT32_MIN;
    PolylineReader bounds(polyline.c_str());
    while (bounds.next(lat, lng)) {
        minLat = min(minLat, lat);
        maxLat = max(maxLat, lat);
        minLng = min(minLng, lng);
        maxLng = max(maxLng, lng);
    }
    if (minLat > maxLat) return;  // no points

    // A degree of longitude gets shorter towards the poles
    const float midLatRad = (minLat + maxLat) / 2 * 1e-5f * DEG_TO_RAD;
    const float lngFactor = cosf(midLatRad);
    const float routeW = (maxLng - minLng) * lngFactor;
    const float routeH = maxLat - minLat;

    const int16_t boxX = display.width() / 2 + MAP_MARGIN;
    const int16_t boxY = HEADING_START_Y + 20 + MAP_MARGIN;  // below the heading line
    const int16_t boxW = display.width() - boxX - MAP_MARGIN;
    const int16_t boxH = display.height() - FOOTER_SIZE_Y - MAP_MARGIN - boxY;

    // Same scale on both axes, so the route isn't distorted; centered in the box
    const float scale =
        min(routeW > 0 ? boxW / routeW : INFINITY, routeH > 0 ? boxH / routeH : INFINITY);
    const float s = isinf(scale) ? 0 : scale;  // a single point: draw it in the center
    const float offsetX = boxX + (boxW - routeW * s) / 2;
    const float offsetY = boxY + (boxH - routeH * s) / 2;

    PolylineReader route(polyline.c_str());
    int16_t prevX = 0, prevY = 0;
    bool first = true;
    while (route.next(lat, lng)) {
        const int16_t x = offsetX + (lng - minLng) * lngFactor * s;
        const int16_t y = offsetY + (maxLat - lat) * s;  // north is up
        if (first) {
            display.fillCircle(x, y, MAP_LINE_WIDTH, GxEPD_BLACK);  // start point
            first = false;
        } else {
            // Thick line: the same line shifted by up to ±1 px in both directions
            for (int8_t d = -(MAP_LINE_WIDTH / 2); d <= MAP_LINE_WIDTH / 2; d++) {
                display.drawLine(prevX + d, prevY, x + d, y, GxEPD_BLACK);
                display.drawLine(prevX, prevY + d, x, y + d, GxEPD_BLACK);
            }
        }
        prevX = x;
        prevY = y;
    }
}

static void drawFooter() {
    display.setFont(&FreeSans12pt8b);
    const int16_t y = display.height() - (FOOTER_SIZE_Y / 2);

    // center the text horizontally, whatever its length
    int16_t x1, y1;
    uint16_t w, h;
    display.getTextBounds(VERSION, 0, y, &x1, &y1, &w, &h);
    display.setCursor((display.width() - w) / 2 - x1, y);
    printText(VERSION);
}

void drawActivity(StravaActivity act) {
    display.setFullWindow();
    display.firstPage();
    do {
        display.fillScreen(GxEPD_WHITE);
        display.setTextColor(GxEPD_BLACK);

        drawHeading(act.name.c_str(), act.achievement_count, iconForSportType(act.type.c_str()));

        drawActivityStats(act);

        if (act.showMap) {
            display.drawLine(display.width() / 2, BODY_START_Y, display.width() / 2,
                             display.height() - (FOOTER_SIZE_Y * 2), GxEPD_BLACK);

            drawActivityMap(act.map);
        }

        drawFooter();

    } while (display.nextPage());
}

void drawError(const char *message) {
    display.setFullWindow();
    display.firstPage();
    do {
        display.fillScreen(GxEPD_WHITE);
        display.setTextColor(GxEPD_BLACK);
        drawHeading("Error:", 0, Icon::Error);
        display.setCursor(BODY_START_X, BODY_START_Y);
        printText(message);
    } while (display.nextPage());
}

void drawIconOverviewScreen() {
    display.setFullWindow();
    display.firstPage();
    do {
        drawIconOverview(display, GxEPD_BLACK, GxEPD_WHITE);
    } while (display.nextPage());
}

void hibernateDisplay() {
    display.hibernate();
}

void initDisplay() {
    SPI.end();
    SPI.begin(13, 12, 14, 15);  // SCK=13, MISO=12 (unused), MOSI=14, SS=15
    display.init(115200, true, 2, false);
    display.setRotation(0);
}
